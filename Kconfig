## Kconfig
```kconfig
# tuyaopen-core unified Kconfig entry
#
# Used as a submodule: the host project only needs to rsource this file from
# its own Kconfig, for example
#     rsource "third_party/tuyaopen-core/Kconfig"
# (rsource paths are relative to this file's directory, so the host may place
# it anywhere.)
#
# The generated .config looks like CONFIG_ENABLE_BLUETOOTH=y and can be passed
# to this repository's CMake directly:
#     cmake -DCONFIG_ENABLE_BLUETOOTH=y ...
# TuyaOpenOptions.cmake normalizes y/1/on to ON.
# Boolean switch defaults match the option() calls in cmake/TuyaOpenOptions.cmake.

menu "tuyaopen-core"

    rsource "third_party/Kconfig"
    rsource "iot-core/Kconfig"
    rsource "agent-core/Kconfig"
    rsource "p2p-core/Kconfig"

    # Connectivity layer switches
    config ENABLE_WIRED
        bool "ENABLE_WIRED: wired (Ethernet) support"
        default n
        help
            Build the wired (Ethernet) support: the application-level
            tal_netif and the wired TKL implementation in port. Maps to
            CONFIG_ENABLE_WIRED.

    config ENABLE_BLUETOOTH
        bool "ENABLE_BLUETOOTH: BLE support"
        default n
        help
            Build the BlueZ based TKL BLE implementation in port (needs
            glib/bluez/dbus at build time). Maps to CONFIG_ENABLE_BLUETOOTH.

    config ENABLE_NIMBLE
        bool "ENABLE_NIMBLE: bundle the NimBLE host stack"
        depends on ENABLE_BLUETOOTH
        default n
        help
            NimBLE host stack bundle switch, kept for parity with the
            CONFIG_ENABLE_NIMBLE option in TuyaOpenOptions.cmake.

    config ENABLE_EXT_RAM
        bool "ENABLE_EXT_RAM: external RAM (PSRAM) allocation"
        default n
        help
            Mount the ex-RAM ops members (.ex_ram_malloc/.ex_ram_free) on the
            port card and build core's tal_ex_ram_malloc/tal_ex_ram_free.
            Maps to CONFIG_ENABLE_EXT_RAM.

            OFF by default. On Linux the port has no separate external RAM,
            so the members degenerate to the normal heap; on MCU targets they
            must be backed by real PSRAM (see the esp32 port).

    config LITTLE_END
        bool "LITTLE_END: target is little-endian"
        default y
        help
            Target byte order, consumed by the pjproject port (mapped to
            PJ_IS_LITTLE_ENDIAN). Leave on for the LINUX port.

endmenu
```

## agent-core/Kconfig
```kconfig
config ENABLE_AI_COMPONENTS
    bool "enable ai components"
    default n
    help
        Master switch for the tuya.ai service layer (tuya_ai_service: AI
        protocol/transport, codec registry and the MCP server core).
        Application-side components (agent / audio player / skills / MCP
        tools) live with the application (see examples/agent_demo/components).
        Leave off for projects that do not need it so it is not compiled in.
        Maps to the CMake switch CONFIG_ENABLE_AI_COMPONENTS.

# 服务层（svc_* 参数）始终参与配置
# （2026-10-13 扁平化：原 tuya_ai_service/Kconfig 合并至此，rsource 路径
#   随目录提升同步为 svc_*/Kconfig）
menu "configure tuya AI"

    config ENABLE_AI_MONITOR
        bool "enable ai monitor (tcp debug service)"
        default y
        help
            AI 协议调试监视服务：TCP 监听（默认端口 5055）输出 AI 协议流，
            供排查链路问题。注意：本符号此前只出现在 .config、缺 Kconfig 定义
            与 CMake 宏注入，属"孤儿配置"（开了不生效）；本次接通。

    rsource "svc_ai_basic/Kconfig"
    # MCP server 核心（工具集在应用层，同用此开关门控）
    rsource "svc_ai_mcp/Kconfig"
endmenu
```

## agent-core/ai_audio/Kconfig
```kconfig
menuconfig ENABLE_COMP_AI_AUDIO
    bool "enable ai audio playback orchestration"
    default n
    select ENABLE_AI_PLAYER
    help
        Enable the AI audio orchestration module (agent-core/ai_audio):
        TTS stream playback and music playlist playback on top of the
        audio_player component (svc_ai_player interface). Selects
        ENABLE_AI_PLAYER automatically.

        Note: the upstream input side (ai_audio_input, tdl_audio based) is
        NOT ported in this tree; the uplink audio path goes through the
        port contract instead (see examples/agent_demo). The upstream
        input-codec choice (PCM/OPUS/SPEEX) is therefore not restored
        either -- it only served the removed input side.

if (ENABLE_COMP_AI_AUDIO)
    choice AI_PLAYER_ALERT_SOURCE
        prompt "select player alert source"
        default AI_PLAYER_ALERT_SOURCE_LOCAL

        config AI_PLAYER_ALERT_SOURCE_LOCAL
            bool "use local alert source"
            help
                Phase 1 does not port the local alert assets (media_src.h
                LOCAL_ALERT_SRC_*, ~2MB); alerts are skipped with a warning.
                Phase 2 restores the assets.

        config AI_PLAYER_ALERT_SOURCE_CUSTOM
            bool "use custom alert source"
            help
                The application registers its own alert callback via
                ai_audio_player_reg_alert_cb().

    # 上游第三个选项 AI_PLAYER_ALERT_SOURCE_CLOUD 依赖已删除的
    # ai_agent_cloud_alert（③层公开面无消费者删除），故不恢复。

    endchoice
endif
```

## agent-core/audio_player/Kconfig
```kconfig
# AI 播放器开关（audio_player 模块，上游 src/audio_player 移植）。
# 默认值与 agent-core/audio_player/CMakeLists.txt 的 CONFIG_ENABLE_AI_PLAYER
# 及 svc_ai_player.h 的 #ifndef 兜底保持一致。
menuconfig ENABLE_AI_PLAYER
    bool "ENABLE_AI_PLAYER: Enable AI player"
    default n
    help
        Enable the AI audio player (MP3/WAV playback from memory, file or URL).
        Platform audio output is injected by the port through
        tuya_ai_player_set_consumer(); without it the built-in no-op consumer
        is used (decoding still runs, PCM is discarded).

    if (ENABLE_AI_PLAYER)
        config AI_PLAYER_STACK_SIZE
            int "AI_PLAYER_STACK_SIZE: player thread stack size"
            default 5120
        config AI_PLAYER_FRAMEBUF_SIZE
            int "AI_PLAYER_FRAMEBUF_SIZE: player frame buf size"
            default 4096
        config AI_PLAYER_DECODEBUF_SIZE
            int "AI_PLAYER_DECODEBUF_SIZE: player decode buf size"
            default 8192
        config AI_PLAYER_RINGBUF_SIZE
            int "AI_PLAYER_RINGBUF_SIZE: player ring buf size"
            default 16384
        config AI_PLAYER_HTTP_YIELD_MS
            int "AI_PLAYER_HTTP_YIELD_MS: player http yield ms"
            range 1 100
            default 10
        config AI_PLAYER_HTTP_TIMEOUT_S
            int "AI_PLAYER_HTTP_TIMEOUT_S: player http timeout seconds"
            range 60 300
            default 180
        menu "Decoder Options"
            # 二期范围：本仓暂无 libopus / libogg 与解码实现，两个开关打开会
            # 在 CMake 阶段 FATAL_ERROR（见 CMakeLists.txt），保留条件结构备用。
            config ENABLE_AI_PLAYER_DECODER_OPUS
                bool "ENABLE_AI_PLAYER_DECODER_OPUS: Enable OPUS decoder without any container (phase 2, not ported)"
                default n
            config AI_PLAYER_DECODER_OPUS_FRAME_SIZE
                depends on ENABLE_AI_PLAYER_DECODER_OPUS
                int "AI_PLAYER_DECODER_OPUS_FRAME_SIZE: OPUS decoder frame size in ms"
                default 40
                range 10 60
            config AI_PLAYER_DECODER_OPUS_KBPS
                depends on ENABLE_AI_PLAYER_DECODER_OPUS
                int "AI_PLAYER_DECODER_OPUS_KBPS: OPUS decoder kbps, 16kbps or 24kbps is recommended"
                default 16
                range 16 128
            config ENABLE_AI_PLAYER_DECODER_OGGOPUS
                depends on ENABLE_AI_PLAYER_DECODER_OPUS
                bool "ENABLE_AI_PLAYER_DECODER_OGGOPUS: Enable OGGOPUS decoder (phase 2, not ported)"
                default n
        endmenu # Decoder Options
    endif # ENABLE_AI_PLAYER
```

## agent-core/tuya_ai_service/Kconfig
```kconfig
menu "configure tuya AI"

    config ENABLE_AI_MONITOR
        bool "enable ai monitor (tcp debug service)"
        default y
        help
            AI 协议调试监视服务：TCP 监听（默认端口 5055）输出 AI 协议流，
            供排查链路问题。注意：本符号此前只出现在 .config、缺 Kconfig 定义
            与 CMake 宏注入，属"孤儿配置"（开了不生效）；本次接通。

    rsource "svc_ai_agent/Kconfig"
    rsource "svc_ai_basic/Kconfig"
    rsource "svc_ai_codec/Kconfig"
    # MCP server 核心（工具集在应用层，同用此开关门控）
    rsource "svc_ai_mcp/Kconfig"
endmenu
```

## core-ai/Kconfig
```kconfig
config ENABLE_AI_COMPONENTS
    bool "enable ai components"
    default n
    help
        Master switch for the tuya.ai component collection (ai_main, ai_agent,
        ai_audio, ai_mcp, ai_video, utility). Leave off for projects that do
        not need it so it is not compiled in. Maps to the CMake switch
        CONFIG_ENABLE_AI_COMPONENTS.

# 服务层（tuya_ai_service 及 svc_* 参数、ENABLE_TUYA_CODEC 系列）始终参与配置
rsource "tuya_ai_service/Kconfig"

if (ENABLE_AI_COMPONENTS)
menu "configure ai components"
    choice
        prompt "choose ai language"
        default ENABLE_AI_LANGUAGE_CHINESE

        config ENABLE_AI_LANGUAGE_CHINESE
            bool "Chinese"

        config ENABLE_AI_LANGUAGE_ENGLISH
            bool "English"
    endchoice

    rsource "ai_audio/Kconfig"
    rsource "ai_mcp/Kconfig"
    rsource "ai_video/Kconfig"
endmenu
endif
```

## core-common/Kconfig
```kconfig
# 通用层开关：加密库、KV 存储、系统参数

menu "core common"

    rsource "libtls/Kconfig"
    rsource "tal_kv/Kconfig"
    rsource "tal_system/Kconfig"
    rsource "common/qrcode/Kconfig"

endmenu
```

## core-common/common/qrcode/Kconfig
```kconfig
menu "configure qrcode"

    config ENABLE_QRCODE
        bool "ENABLE_QRCODE: QR code output for Tuya APP binding"
        default n
        help
            Build the qrcode module (qrcodegen + qrencode_print) in
            core-common/common/qrcode and activate the QR printing blocks
            in demos (wired binding prints the pairing QR this way).
            Maps to the CMake switch CONFIG_ENABLE_QRCODE.

endmenu
```

## core-common/tal_kv/Kconfig
```kconfig
# KV 存储层开关

menu "configure tal_kv"

    config ENABLE_FILE_SYSTEM
        bool "ENABLE_FILE_SYSTEM: use the platform file system for kv"
        default n
        help
            Use tkl_fs for kv persistence. Turn off to compile the bundled
            littlefs in tal_kv instead (default). Maps to the CMake switch
            CONFIG_ENABLE_FILE_SYSTEM.

endmenu
```

## core-communication/Kconfig
```kconfig
# 连接层开关：有线、WiFi（含低功耗）、蓝牙

menu "connectivity"

    config ENABLE_WIRED
        bool "ENABLE_WIRED: wired (Ethernet) support"
        default n
        help
            Build tal_wired, the wired netmgr source and the wired TKL
            implementation in port. Maps to CONFIG_ENABLE_WIRED.

    config ENABLE_WIFI
        bool "ENABLE_WIFI: WiFi support"
        default n
        help
            Build tal_wifi, the WiFi netcfg/netmgr sources and the
            wpa_supplicant based TKL implementation in port. Maps to
            CONFIG_ENABLE_WIFI. Runtime needs wpa_supplicant.

    rsource "tal_wifi_ulp/Kconfig"

    config ENABLE_BLUETOOTH
        bool "ENABLE_BLUETOOTH: BLE support"
        default n
        help
            Build tal_bluetooth, the BLE cloud sources and the BlueZ based
            TKL implementation in port (needs glib/bluez/dbus at build
            time). Maps to CONFIG_ENABLE_BLUETOOTH.

    if ENABLE_BLUETOOTH

        config ENABLE_NIMBLE
            bool "ENABLE_NIMBLE: bundle the NimBLE host stack"
            default n
            help
                Compile the NimBLE sources bundled in tal_bluetooth instead
                of relying on the port BLE stack only. Maps to
                CONFIG_ENABLE_NIMBLE.

        if ENABLE_NIMBLE
            config TUYA_HS_BLE_HOST_TASK_PRIORITY
                int "TUYA_HS_BLE_HOST_TASK_PRIORITY: bt host task priority"
                range 0 100
                default 9

            config TUYA_HS_BLE_HOST_STACK_SIZE
                int "TUYA_HS_BLE_HOST_STACK_SIZE: bt host task stack size"
                range 0 10000
                default 5120
        endif

    endif

endmenu
```

## iot-core/tuya_transport/Kconfig
```kconfig
menu "configure mbedtls"

    config ENABLE_PLATFORM_MBEDTLS
        bool "ENABLE_PLATFORM_MBEDTLS: use mbedtls from the platform"
        default n
        help
            Use the mbedtls shipped by the platform instead of the copy
            bundled in tal_security/libtls/mbedtls-3.1.0. Maps to the CMake
            switch CONFIG_ENABLE_PLATFORM_MBEDTLS.

    config ENABLE_MBEDTLS_DEBUG
        bool "Enable mbedTLS debugging"
        default n
        help
            Enable mbedTLS debugging functions at compile time.

            If this option is enabled, you can include
            "mbedtls/esp_debug.h" and call mbedtls_esp_enable_debug_log()
            at runtime in order to enable mbedTLS debug output via the ESP
            log mechanism.

        config ENABLE_MBEDTLS_DEBUG_LEVEL
            int "debug level set"
            range 0 5
            depends on ENABLE_MBEDTLS_DEBUG
            default 1
  
    config ENABLE_MBEDTLS_SSL_MAX_CONTENT_LEN
            int "TLS maximum message content length"            
            default 1024
            range 512 16384        
            help
                Maximum TLS message length (in bytes) supported by mbedTLS.

                16384 is the default and this value is required to comply
                fully with TLS standards.

                However you can set a lower value in order to save RAM. This
                is safe if the other end of the connection supports Maximum
                Fragment Length Negotiation Extension (max_fragment_length,
                see RFC6066) or you know for certain that it will never send a
                message longer than a certain number of bytes.

                If the value is set too low, symptoms are a failed TLS
                handshake or a return value of MBEDTLS_ERR_SSL_INVALID_RECORD
                (-0x7200). 

endmenu  # mbedTLS
```

## third_party/Kconfig
```kconfig
# 通用层开关：KV 存储
# （qrcode 已移至应用层 examples/qrcode（公共组件），tal_system 与
#  mbedtls 配置菜单随连接服务层 tuya_transport 归入 iot-core）

menu "third party"


endmenu
```
